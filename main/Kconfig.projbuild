## main/Kconfig.projbuild
```kconfig
menu "Alles"

config ALLES_ATOM_VOICE
    bool "Build for the M5Stack Atom Voice"
    depends on IDF_TARGET_ESP32
    default n
    help
        Build for the M5Stack Atom Voice (ESP32-PICO-D4, NS4168 I2S amp, one button)
        instead of the Alles boards. The ESP32-S3 target always builds for the Atom VoiceS3R.

endmenu
```

## sdkconfig.defaults
```kconfig
# Alles for M5Stack Atom VoiceS3R (ESP32-S3-PICO-1-N8R8)
CONFIG_IDF_TARGET="esp32s3"

# Flash: 8MB QIO, PSRAM: 8MB Octal
CONFIG_ESPTOOLPY_FLASHMODE_QIO=y
CONFIG_ESPTOOLPY_FLASHFREQ_80M=y
CONFIG_ESPTOOLPY_FLASHSIZE_8MB=y
CONFIG_SPIRAM=y
CONFIG_SPIRAM_MODE_OCT=y
CONFIG_SPIRAM_SPEED_80M=y

CONFIG_PARTITION_TABLE_CUSTOM=y
CONFIG_PARTITION_TABLE_CUSTOM_FILENAME="alles_partitions.csv"
CONFIG_PARTITION_TABLE_FILENAME="alles_partitions.csv"

# Console over the native USB Serial/JTAG port
CONFIG_ESP_CONSOLE_USB_SERIAL_JTAG=y

CONFIG_ESP_DEFAULT_CPU_FREQ_MHZ_240=y
CONFIG_COMPILER_OPTIMIZATION_PERF=y
CONFIG_APP_COMPILE_TIME_DATE=y

CONFIG_ESP_MAIN_TASK_STACK_SIZE=8192
CONFIG_ESP_SYSTEM_EVENT_TASK_STACK_SIZE=2304
CONFIG_ESP_INT_WDT_TIMEOUT_MS=300
CONFIG_ESP_TASK_WDT_TIMEOUT_S=5

# CPU usage reporting (esp_show_debug)
CONFIG_FREERTOS_HZ=1000
CONFIG_FREERTOS_USE_TRACE_FACILITY=y
CONFIG_FREERTOS_USE_STATS_FORMATTING_FUNCTIONS=y
CONFIG_FREERTOS_GENERATE_RUN_TIME_STATS=y

CONFIG_HTTPD_MAX_REQ_HDR_LEN=512
CONFIG_HTTPD_MAX_URI_LEN=512
CONFIG_HTTPD_ERR_RESP_NO_DELAY=y
CONFIG_HTTPD_PURGE_BUF_LEN=32
CONFIG_ESP_HTTPS_OTA_ALLOW_HTTP=y

CONFIG_LWIP_MAX_SOCKETS=10
CONFIG_LWIP_SO_REUSE=y
CONFIG_LWIP_SO_REUSE_RXTOALL=y
CONFIG_LWIP_NETIF_LOOPBACK=y

CONFIG_ESP_WIFI_STATIC_RX_BUFFER_NUM=10
CONFIG_ESP_WIFI_DYNAMIC_RX_BUFFER_NUM=32

# esp32-wifi-manager
CONFIG_WIFI_MANAGER_TASK_PRIORITY=5
CONFIG_WIFI_MANAGER_RETRY_TIMER=5000
CONFIG_WIFI_MANAGER_MAX_RETRY_START_AP=3
CONFIG_WIFI_MANAGER_SHUTDOWN_AP_TIMER=60000
CONFIG_WEBAPP_LOCATION="/"
CONFIG_DEFAULT_AP_SSID="alles"
CONFIG_DEFAULT_AP_PASSWORD="alles"
CONFIG_DEFAULT_AP_CHANNEL=1
CONFIG_DEFAULT_AP_IP="10.10.0.1"
CONFIG_DEFAULT_AP_GATEWAY="10.10.0.1"
CONFIG_DEFAULT_AP_NETMASK="255.255.255.0"
CONFIG_DEFAULT_AP_MAX_CONNECTIONS=4
CONFIG_DEFAULT_AP_BEACON_INTERVAL=100
```
